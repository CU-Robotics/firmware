/*
 * This file is part of the OpenMV project.
 *
 * Copyright (c) 2013-2021 Ibrahim Abdelkader <iabdalkader@openmv.io>
 * Copyright (c) 2013-2021 Kwabena W. Agyeman <kwagyeman@openmv.io>
 *
 * This work is licensed under the MIT license, see the file LICENSE for
 * details.
 *
 * OV5640 driver.
 *
 * Note: Some mods made to get JPEG working and other minor things, like
 * special effects, white balance, night mode, hue, sharpness.
 */

#include "OV5640.h"
#include "OV5640_regs.h"

#define debug Serial
// #define NO_CLK_PIN

#define DEBUG_CAMERA
// #define DEBUG_CAMERA_VERBOSE
// #define DEBUG_FLEXIO
// #define USE_DEBUG_PINS
#define DEBUG_CAMERA_REG
#define USE_VSYNC_PIN_INT

// #define USE_DEBUG_PINS_TIMING

#ifdef USE_DEBUG_PINS_TIMING
#define DBGdigitalWriteFast digitalWriteFast
#define DBGdigitalToggleFast digitalToggleFast
#else
static inline void DBGdigitalWriteFast(uint8_t pin, uint8_t val)
    __attribute__((always_inline, unused));
static inline void DBGdigitalWriteFast(uint8_t pin, uint8_t val) {}
static inline void DBGdigitalToggleFast(uint8_t pin)
    __attribute__((always_inline, unused));
static inline void DBGdigitalToggleFast(uint8_t pin){}
#endif

// if not defined in the variant
#ifndef digitalPinToBitMask
#define digitalPinToBitMask(P) (1 << (digitalPinToPinName(P) % 64))
#endif

#ifndef portInputRegister
#define portInputRegister(P) ((P == 0) ? &NRF_P0->IN : &NRF_P1->IN)
#endif

/** ln(10) */
#ifndef LN10
#define LN10 2.30258509299404568402f
#endif /* !M_LN10 */

/* log_e 2 */
#ifndef LN2
#define LN2 0.69314718055994530942
#endif /*!M_LN2 */

#define LOG2_2(x) (((x) & 0x2ULL) ? (2) : 1) // NO ({ ... }) !
#define LOG2_4(x) \
    (((x) & 0xCULL) ? (2 + LOG2_2((x) >> 2)) : LOG2_2(x)) // NO ({ ... }) !
#define LOG2_8(x) \
    (((x) & 0xF0ULL) ? (4 + LOG2_4((x) >> 4)) : LOG2_4(x)) // NO ({ ... }) !
#define LOG2_16(x) \
    (((x) & 0xFF00ULL) ? (8 + LOG2_8((x) >> 8)) : LOG2_8(x)) // NO ({ ... }) !
#define LOG2_32(x)                                     \
    (((x) & 0xFFFF0000ULL) ? (16 + LOG2_16((x) >> 16)) \
                           : LOG2_16(x)) // NO ({ ... }) !
#define LOG2(x)                                                \
    (((x) & 0xFFFFFFFF00000000ULL) ? (32 + LOG2_32((x) >> 32)) \
                                   : LOG2_32(x)) // NO ({ ... }) !

// Sensor frame size/resolution table.
const int resolution[][2] = {
    {640, 480},   /* VGA   */
    {160, 120},   /* QQVGA */
    {320, 240},   /* QVGA  */
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    {1280, 1024}, /* SXGA  */
    // 3MP Sensors
    {1920, 1080}, /* FHD   */
    {720, 1280},  /* Portrait HD   */
    {864, 1536},  /* Portrait 3MP   */
    {2048, 1536}, /* QXGA  */
    // 5MP Sensors
    {2560, 1440}, /* QHD    */
    {2560, 1600}, /* WQXGA  */
    {1088, 1920}, /* Portrait FHD   */
    {2560, 1920}, /* QSXGA  */
    {1024, 600},  /* RA8876 */
    {0, 0},
};

#define BLANK_LINES 8
#define DUMMY_LINES 6

#define BLANK_COLUMNS 0
#define DUMMY_COLUMNS 8

#define SENSOR_WIDTH 2624
#define SENSOR_HEIGHT 1964

#define ACTIVE_SENSOR_WIDTH (SENSOR_WIDTH - BLANK_COLUMNS - (2 * DUMMY_COLUMNS))
#define ACTIVE_SENSOR_HEIGHT (SENSOR_HEIGHT - BLANK_LINES - (2 * DUMMY_LINES))

#define DUMMY_WIDTH_BUFFER 16
#define DUMMY_HEIGHT_BUFFER 8

#define HSYNC_TIME 252
#define VYSNC_TIME 24

static int16_t readout_x = 0;
static int16_t readout_y = 0;

static uint16_t readout_w = ACTIVE_SENSOR_WIDTH;
static uint16_t readout_h = ACTIVE_SENSOR_HEIGHT;

static uint16_t hts_target = 0;

static const uint8_t default_regs[][3] = {

    // https://github.com/ArduCAM/Arduino/blob/master/ArduCAM/ov5640_regs.h

    {0x47, 0x40, 0x20},
    {0x40, 0x50, 0x6e},
    {0x40, 0x51, 0x8f},
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    {0x30, 0x36, 0x60}, // wasOMV_OV5640_PLL_CTRL2}, // { 0x30, 0x36, 0x46 },
    {0x30, 0x37, OMV_OV5640_PLL_CTRL3},
    {0x30, 0x38, 0x00},
    {0x30, 0x39, 0x00},
    {0x38, 0x0c, 0x07},
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    {0x30, 0x08, 0x02},

    // OpenMV Custom.

    {0x3a, 0x02, 0x07},
    {0x3a, 0x03, 0xae},
    {0x3a, 0x08, 0x01},
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    {0x47, 0x23, 0x03}, // DVP JPEG Mode456 Skip Line Number

    // End.

    {0x00, 0x00, 0x00}};

static uint8_t af_firmware_regs[] = {
    0x02, 0x0f, 0xd6, 0x02, 0x0a, 0x39, 0xc2, 0x01, 0x22, 0x22, 0x00, 0x02, 0x0f, 0xb2, 0xe5, 0x1f, // 0x8000,
    0x70, 0x72, 0xf5, 0x1e, 0xd2, 0x35, 0xff, 0xef, 0x25, 0xe0, 0x24, 0x4e, 0xf8, 0xe4, 0xf6, 0x08, // 0x8010,
    0xf6, 0x0f, 0xbf, 0x34, 0xf2, 0x90, 0x0e, 0x93, 0xe4, 0x93, 0xff, 0xe5, 0x4b, 0xc3, 0x9f, 0x50, // 0x8020,
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    0x0c, 0x98, 0x8f, 0x82, 0x8e, 0x83, 0x75, 0xf0, 0x04, 0xed, 0x02, 0x06, 0xa5                    // 0x8fe0

};
/*
static const uint8_t af_firmware_command_regs[][3] = {
    {0x30, 0x22, 0x03}, {0x30, 0x23, 0x00}, {0x30, 0x24, 0x00}, {0x30, 0x25, 0x00}, {0x30, 0x26, 0x00}, {0x30, 0x27, 0x00}, {0x30, 0x28, 0x00}, {0x30, 0x29, 0x7f},
    {0x00, 0x00, 0x00}};
*/
#define NUM_BRIGHTNESS_LEVELS (9)

#define NUM_CONTRAST_LEVELS (7)
static const uint8_t contrast_regs[NUM_CONTRAST_LEVELS][1] = {
    {0x14}, /* -3 */
    {0x18}, /* -2 */
    {0x1C}, /* -1 */
    {0x00}, /* +0 */
    {0x10}, /* +1 */
    {0x18}, /* +2 */
    {0x1C}, /* +3 */
};

#define NUM_SATURATION_LEVELS (9)
static const uint8_t saturation_regs[NUM_SATURATION_LEVELS][2] = {
    {0x00, 0x00}, /* -4 */
    {0x10, 0x10}, /* -3 */
    {0x20, 0x20}, /* -2 */
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    {0x80, 0x80}, /* +4 */
};

#define NUM_WB_MODES (5)
static const uint8_t wb_modes_regs[NUM_WB_MODES][7] = {
    {0x00, 0x04, 0x00, 0x04, 0x00, 0x04, 0x00}, /* auto */
    {0x01, 0x06, 0x1c, 0x04, 0x00, 0x04, 0xf3}, /* sunny */
    {0x01, 0x06, 0x48, 0x04, 0x00, 0x04, 0xd3}, /* cloudy */
    {0x01, 0x05, 0x48, 0x04, 0x00, 0x07, 0xcf}, /* office */
    {0x01, 0x04, 0x10, 0x04, 0x00, 0x08, 0x50}, /* home */
};

#define NUM_SPECIAL_EFFECTS (9)
static const uint8_t special_effects_regs[NUM_SPECIAL_EFFECTS][4] = {
    {0x06, 0x40, 0x10, 0x08}, /* no effect */
    {0x40, 0x08, 0x40, 0x10}, /* negative */
    {0x1e, 0x80, 0x80, 0x08}, /* black and white */
    {0x1e, 0x80, 0xc0, 0x08}, /* reddish */
    {0x1e, 0x60, 0x60, 0x08}, /* greenish */
    {0x1e, 0xa0, 0x40, 0x08}, /* blue */
    {0x1e, 0x40, 0xa0, 0x08}, /* retro */
    {0x1e, 0xf0, 0xf0, 0x08}, /* Overexposure */
    {0x06, 0x40, 0x10, 0x09}  /* Solarize */

};

#define NUM_HUE_LEVELS (12)
static const uint8_t hue_regs[NUM_HUE_LEVELS][3] = {
    {0x80, 0x00, 0x32}, /* -180, -6*/
    {0x64, 0x40, 0x32}, /* -150, -5 */
    {0x40, 0x6F, 0x32}, /* -120, -4*/
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    {0x6f, 0x40, 0x31}, /* +150, +5 */
};

#define NUM_SHARPNESS_LEVELS (9)
static const uint8_t sharpness_regs[NUM_SHARPNESS_LEVELS][1] = {
    {0x00}, /* OFF */
    {0x02}, /* 1 */
    {0x04},
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    {0x14}, /* 8 */
};

/********************************************************/

// const int OV5640_D[8] = {OV5640_D0, OV5640_D1, OV5640_D2, OV5640_D3,
//                          OV5640_D4, OV5640_D5, OV5640_D6, OV5640_D7};

OV5640::OV5640()
    : _OV5640(NULL), _saturation(3), _hue(0), _frame_buffer_pointer(NULL) {
}

// Read a single uint8_t from address and return it as a uint8_t
uint8_t OV5640::cameraReadRegister(uint16_t reg_addr, uint8_t &reg_data) {
    _wire->beginTransmission(0x3C);
    _wire->write(reg_addr >> 8);
    _wire->write(reg_addr);
    if (_wire->endTransmission(false) != 0) {
        if (_debug) {
            debug.println("error reading OV5640, address");
            // print what register we're trying to read
            debug.printf("reg_addr = %04x\n", reg_addr);
        }
        return 0;
    }
    if (_wire->requestFrom(0x3C, 1) < 1) {
        Serial.println("error reading OV5640, data");
        return 0;
    }
    int ret = _wire->read();
    delay(1);
    if (ret < 0) {
        return 1;
    } else {
        uint8_t ret_data = ret;
        reg_data = ret_data;
    }
    return 0;
}

uint8_t OV5640::cameraWriteRegister(uint16_t reg, uint8_t data) {
    _wire->beginTransmission(0x3C);
    _wire->write(reg >> 8);
    _wire->write(reg);
    _wire->write(data);
    if (_wire->endTransmission() != 0) {
        if (_debug)
            debug.println("error writing to OV5640");
        return 1;
    }
    return 0;
}

uint8_t OV5640::cameraWriteFirmware() {
    uint32_t write_count = 0;
    uint16_t reg = 0;

    /* try this next */
    uint8_t cb_write = 128;
    uint16_t cb_left = sizeof(af_firmware_regs);
    uint8_t *pb = af_firmware_regs;

    while (cb_left) {
        if (cb_left < cb_write)
            cb_left = cb_write;
        _wire->beginTransmission(0x3C);
        reg = MCU_FIRMWARE_BASE + write_count * cb_write;
        _wire->write(reg >> 8);
        _wire->write(reg);
        _wire->write(pb, cb_write);
        _wire->endTransmission(cb_write == cb_left);
        pb += cb_write;
        cb_left -= cb_write;
        write_count += 1;
    }

    return 0;
}

// HTS (Horizontal Time) is the readout width plus the HSYNC_TIME time. However,
// if this value gets too low the OV5640 will crash. The minimum was determined
// empirically with testing... Additionally, when the image width gets too large
// we need to slow down the line transfer rate by increasing HTS so that
// DCMI_DMAConvCpltUser() can keep up with the data rate.
//
// WARNING! IF YOU CHANGE ANYTHING HERE RETEST WITH **ALL** RESOLUTIONS FOR THE
// AFFECTED MODE!
int OV5640::calculate_hts(uint16_t width) {
    uint16_t hts = hts_target;

    if ((_format == GRAYSCALE) || (_format == BAYER) || (_format == JPEG)) {
        if (width <= 1280) {
            hts = max((width * 2) + 8, hts_target);
        }
    } else {
        if (width > 640) {
            hts = max((width * 2) + 8, hts_target);
        }
    }

    if (width <= 640) {
        hts += 160; // Fix image quality at low resolutions.
    }
    return max(hts + HSYNC_TIME,
               (SENSOR_WIDTH + HSYNC_TIME) / 2); // Fix to prevent crashing.
}

// VTS (Vertical Time) is the readout height plus the VYSNC_TIME time. However,
// if this value gets too low the OV5640 will crash. The minimum was determined
// empirically with testing...
//
// WARNING! IF YOU CHANGE ANYTHING HERE RETEST WITH **ALL** RESOLUTIONS FOR THE
// AFFECTED MODE!
int OV5640::calculate_vts(uint16_t readout_height) {
    return max(readout_height + VYSNC_TIME,
               (SENSOR_HEIGHT + VYSNC_TIME) / 8); // Fix to prevent crashing.
}

uint16_t OV5640::getModelid() {
    uint8_t Data = 0;
    uint16_t MID = 0x0000;
#ifdef DEBUG_CAMERA
    debug.println("entered getModelid");
#endif

    cameraReadRegister(0x300A, Data);
    MID = (Data << 8);

    cameraReadRegister(0x300B, Data);
    MID |= Data;

#ifdef DEBUG_CAMERA
    debug.printf("Exiting getModelid: MID = %04x\n", MID);
#endif
    return MID;
}

#ifdef DEBUG_CAMERA
void print_pin_info(const char *pin_name, uint8_t pin) {
    Serial.printf("\t%s(%d)", pin_name, pin);
    if (pin >= CORE_NUM_DIGITAL)
        Serial.println(" ** unused **");
    else {
        Serial.printf(": %08x %08x\n", *(portControlRegister(pin)), *(portConfigRegister(pin)));
    }
}
#endif

bool OV5640::begin_omnivision(framesize_t framesize, pixformat_t format,
                              int fps, int camera_name, bool use_gpio) {

    _use_gpio = use_gpio;

    // WIP - Need set functions:
    if (_rst != 0xff) {
        if (_rst_init >= 0) {
            pinMode(_rst, OUTPUT);
            digitalWrite(_rst, _rst_init);
        } else if (_rst_init == -1)
            pinMode(_rst, INPUT);
        else if (_rst_init == -2)
            pinMode(_rst, INPUT_PULLUP);
        else if (_rst_init == -3)
            pinMode(_rst, INPUT_PULLDOWN);
        delay(5);
    }

    if (_pwdn != 0xff) {
        if (_pwdn_init >= 0) {
            pinMode(_pwdn, OUTPUT);
            digitalWrite(_pwdn, _pwdn_init);
        } else if (_pwdn_init == -1)
            pinMode(_pwdn, INPUT);
        else if (_pwdn_init == -2)
            pinMode(_pwdn, INPUT_PULLUP);
        else if (_pwdn_init == -3)
            pinMode(_pwdn, INPUT_PULLDOWN);
        delay(5);
    }

// BUGBUG::: see where frame is
#ifdef USE_DEBUG_PINS
    pinMode(49, OUTPUT);
#endif

    //_wire = &Wire;
    _wire->begin();

    // Configure Camera Resolution
    _width = resolution[framesize][0];
    if (_width == 0) {
        if (_debug)
            debug.println("Frame Size Invalid!!!");
        return false;
    }
    _height = resolution[framesize][1];
    _framesize = (uint8_t)framesize;

    // Configure pixel format
    _grayscale = false;
    switch (format) {
    case YUV422:
        _bytesPerPixel = 2;
        _format = 0;
        break;
    case PIXFORMAT_BAYER:
    case BAYER:
        _bytesPerPixel = 2;
        _format = 1;
        break;
    case RGB565:
        _bytesPerPixel = 2;
        _format = 2;
        break;
    case PIXFORMAT_GRAYSCALE:
    case GRAYSCALE:
        format = YUV422;    // We use YUV422 but discard U and V bytes
        _bytesPerPixel = 2; // 2 input bytes per pixel of which 1 is discarded
        _grayscale = true;
        _format = 4;
        break;
    case JPEG:
        _bytesPerPixel = 2;
        _format = 8;
        break;
    default:
        return false;
    }

    pinMode(_vsyncPin, INPUT /*INPUT_PULLDOWN*/);
    //  const struct digital_pin_bitband_and_config_table_struct *p;
    //  p = digital_pin_to_info_PGM + _vsyncPin;
    //  *(p->pad) = IOMUXC_PAD_DSE(7) | IOMUXC_PAD_HYS;  // See if I turn on
    //  HYS...
    pinMode(_hrefPin, INPUT);
    pinMode(_pclkPin, INPUT_PULLDOWN);
    pinMode(_xclkPin, OUTPUT);

#ifdef DEBUG_CAMERA
    debug.printf("  VS=%d, HR=%d, PC=%d XC=%d\n", _vsyncPin, _hrefPin, _pclkPin,
                 _xclkPin);
    debug.printf("  RST=%d(%d), PWDN=%d(%d)\n", _rst, _rst_init, _pwdn, _pwdn_init);

    for (int i = 0; i < 8; i++) {
        pinMode(_dPins[i], INPUT_PULLDOWN);
        debug.printf("  _dpins(%d)=%d\n", i, _dPins[i]);
    }
#endif

    _vsyncPort = portInputRegister(digitalPinToPort(_vsyncPin));
    _vsyncMask = digitalPinToBitMask(_vsyncPin);
    _hrefPort = portInputRegister(digitalPinToPort(_hrefPin));
    _hrefMask = digitalPinToBitMask(_hrefPin);
    _pclkPort = portInputRegister(digitalPinToPort(_pclkPin));
    _pclkMask = digitalPinToBitMask(_pclkPin);

    /*
      if(camera_name == OV7670) {
          _xclk_freq = 14;  //was 16Mhz
      } else {
          if(fps <= 10){
           _xclk_freq = 14;
          } else {
          _xclk_freq = 16;
          }
      }
    */

    beginXClk();

    if (_rst != 0xFF) {
        pinMode(_rst, OUTPUT);
        digitalWriteFast(_rst, LOW); /* Reset */
        for (volatile uint32_t i = 0; i < 100000; i++) {
        }
        digitalWriteFast(_rst, HIGH); /* Normal mode. */
        for (volatile uint32_t i = 0; i < 100000; i++) {
        }
    }

    _wire->begin();

    delay(500);
    Serial.println(getModelid(), HEX);
    if (getModelid() != 0x5640) {
        end();
        if (_debug)
            debug.println("Camera detect failed");
        return false;
    }

#ifdef DEBUG_CAMERA
    debug.printf("Calling ov5640_configure\n");
    debug.printf("Cam Name: %d, Format: %d, Resolution: %d, Clock: %d\n",
                 camera_name, _format, _framesize, _xclk_freq);
    debug.printf("Frame rate: %d\n", fps);
#endif

    // flexIO/DMA
    if (!_use_gpio) {
        hardware_configure();
        setVSyncISRPriority(102);
        setDMACompleteISRPriority(192);
    } else {
        setVSyncISRPriority(102);
        setDMACompleteISRPriority(192);
    }

    if (reset() < 0) {
        if (_debug)
            debug.println("Error: RESET failed");
        return false;
    }

    if (setPixformat(format) != 0) {
        if (_debug)
            debug.println("Error: setPixformat failed");
        return false;
    }

    if (setFramesize(framesize) != 0) {
        if (_debug)
            debug.println("Error: setFramesize failed");
        return false; // failed to set resolution
    }

    if (_useAF) {
        if (setAutoFocusMode() != 0) {
            if (_debug)
                debug.println("Error: Failed to setAutoFocusMode");
            return false;
        }
    }

#ifdef DEBUG_CAMERA
    if (_debug) {
        // curious of pin setting between CSI and FlexIO
        Serial.println("\n*** Camera Pin Settings ***");
        print_pin_info("vsyncPin", _vsyncPin);
        print_pin_info("hrefPin", _hrefPin);
        print_pin_info("pclkPin", _pclkPin);
        print_pin_info("xclkPin", _xclkPin);
        print_pin_info("rst", _rst);
        print_pin_info("pwdn", _pwdn);
        print_pin_info("D0", _dPins[0]);
        print_pin_info("D1", _dPins[1]);
        print_pin_info("D2", _dPins[2]);
        print_pin_info("D3", _dPins[3]);
        print_pin_info("D4", _dPins[4]);
        print_pin_info("D5", _dPins[5]);
        print_pin_info("D6", _dPins[6]);
        print_pin_info("D7", _dPins[7]);
    }
#endif

    return true;
}

int OV5640::reset() {
    int ret = 0;
    int ret1 = 0;
    readout_x = 0;
    readout_y = 0;

    readout_w = ACTIVE_SENSOR_WIDTH;
    readout_h = ACTIVE_SENSOR_HEIGHT;

    hts_target = 0;

    // Reset all registers
    ret |= cameraWriteRegister(SCCB_SYSTEM_CTRL_1, 0x11);
    ret |= cameraWriteRegister(SYSTEM_CTROL0, 0x82);

    // Delay 5 ms
    delay(5);

    // Write default registers
    for (int i = 0; default_regs[i][0]; i++) {
        int addr = (default_regs[i][0] << 8) | (default_regs[i][1] << 0);
        int data = default_regs[i][2];

        ret |= cameraWriteRegister(addr, data);
    }

    if (_useAF) {
        cameraWriteRegister(SYSTEM_RESET_00, 0x20);
        debug.println(".... Loading firmware....");
        // Write firmware

        for (uint16_t i = 0; i < sizeof(af_firmware_regs); i++) {
            ret |= cameraWriteRegister(MCU_FIRMWARE_BASE + i, af_firmware_regs[i]);
        }

        // cameraWriteFirmware();
        //  Configure command and status registers for AF
        cameraWriteRegister(OV5640_CMD_MAIN, 0x03);
        cameraWriteRegister(OV5640_CMD_ACK, 0x00);
        cameraWriteRegister(OV5640_CMD_PARA0, 0x00);
        cameraWriteRegister(OV5640_CMD_PARA1, 0x00);
        cameraWriteRegister(OV5640_CMD_PARA2, 0x00);
        cameraWriteRegister(OV5640_CMD_PARA3, 0x00);
        cameraWriteRegister(OV5640_CMD_PARA4, 0x00);
        cameraWriteRegister(OV5640_CMD_FW_STATUS, 0x7f);
        // release mcu reset
        ret |= cameraWriteRegister(SYSTEM_RESET_00, 0x00);

        ret1 |= checkAFCmdStatus(OV5640_CMD_FW_STATUS, AF_STATUS_S_IDLE);

        if (ret1 < 0) {
            if (_debug)
                debug.println("AF config failed to start!!");
        }
        ret |= ret1;

        // Per Adafruit OV5640 need to set step size for motor
        // cameraWriteRegister(OV5640_CMD_PARA3, 0x00);
        // cameraWriteRegister(OV5640_CMD_PARA4, 180); // step size 0-255?
        // cameraWriteRegister(OV5640_CMD_ACK, 0x01);
        // cameraWriteRegister(OV5640_CMD_MAIN, AF_SET_VCM_STEP);
        // ret |= checkAFCmdStatus(OV5640_CMD_ACK, 0x00);
    }

    delay(300);
    return ret;
}

int OV5640::checkAFCmdStatus(uint16_t reg, uint8_t value) {
    uint8_t sensor = 0xFF;
    uint32_t timeout = millis();
    while (sensor != value) {
        cameraReadRegister(reg, sensor);
        // Serial.println(sensor, HEX);
        delay(1);
        if ((millis() - timeout) > 5000) {
            if (_debug)
                debug.printf("AF command: 0x%x failed to start!!\n", value);
            return -1;
        }
    }
    return 0;
}

void OV5640::end() {
    endXClk();
    pinMode(_xclkPin, INPUT);
    _wire->end();
}

int OV5640::setPixformat(pixformat_t pixformat) {
    // const uint8_t(*regs)[2];
    int ret = 0;
    uint8_t reg = 0;

    // Not a multiple of 8. The JPEG encoder on the OV5640 can't handle this.
    if ((_format == JPEG) &&
        ((resolution[_framesize][0] % 8) || (resolution[_framesize][1] % 8))) {
        if (_debug)
            debug.println("JPEG Framesize not divisible by 8........");
        return 1;
    }

    switch (pixformat) {
    case GRAYSCALE:
    case PIXFORMAT_GRAYSCALE:
        ret |= cameraWriteRegister(FORMAT_CONTROL, 0x10);
        ret |= cameraWriteRegister(FORMAT_CONTROL_MUX, 0x00);
        break;
    case RGB565:
        ret |= cameraWriteRegister(FORMAT_CONTROL, 0x6F);
        ret |= cameraWriteRegister(FORMAT_CONTROL_MUX, 0x01);
        break;
    case YUV422:
        ret |= cameraWriteRegister(FORMAT_CONTROL, 0x30);
        ret |= cameraWriteRegister(FORMAT_CONTROL_MUX, 0x00);
        break;
    case BAYER:
    case PIXFORMAT_BAYER:
        ret |= cameraWriteRegister(FORMAT_CONTROL, 0x00);
        ret |= cameraWriteRegister(FORMAT_CONTROL_MUX, 0x01);
        break;
    case JPEG: {
        ret |= cameraWriteRegister(FORMAT_CONTROL, 0x30);
        ret |= cameraWriteRegister(FORMAT_CONTROL_MUX, 0x00);
        ret |= cameraReadRegister(JPEG_MODE_SEL, reg);
        reg &= ~(0x07);
        uint8_t val = 0x03;
        val &= (0x07);
        val |= reg;
        ret |= cameraWriteRegister(JPEG_MODE_SEL, val);
        cameraWriteRegister(TIMING_TC_REG_20, 0x40);
        cameraWriteRegister(SC_PLL_CONTRL2, 0x69);
        cameraWriteRegister(SC_PLL_CONTRL1, 0x31);
    } break;
    default:
        return 1;
    }

    Serial.printf("Format: %d, Framesize: %d\n", pixformat, _framesize);

    ret |= cameraReadRegister(TIMING_TC_REG_21, reg);
    ret |= cameraWriteRegister(
        TIMING_TC_REG_21, (reg & 0xDF) | ((pixformat == JPEG) ? 0x26 : 0x00));

    ret |= cameraReadRegister(SYSTEM_RESET_02, reg);
    ret |= cameraWriteRegister(
        SYSTEM_RESET_02, (reg & 0xE3) | ((pixformat == JPEG) ? 0x00 : 0x1C));

    ret |= cameraReadRegister(CLOCK_ENABLE_02, reg);
    ret |= cameraWriteRegister(
        CLOCK_ENABLE_02, (reg & 0xD7) | ((pixformat == JPEG) ? 0x28 : 0x00));

    if (hts_target) {
        uint16_t sensor_hts = calculate_hts(resolution[_framesize][0]);

        ret |= cameraWriteRegister(TIMING_HTS_H, sensor_hts >> 8);
        ret |= cameraWriteRegister(TIMING_HTS_L, sensor_hts);
    }

    _format = int(pixformat);
    return ret;
}

uint8_t OV5640::setFramesize(framesize_t framesize) {
    if (framesize >= (sizeof(resolution) / sizeof(resolution[0])))
        return 1; // error

    _framesize = framesize;

    return setFramesize(resolution[framesize][0], resolution[framesize][1]);
}

uint8_t OV5640::setFramesize(int w, int h) {
    uint16_t sensor_w = 0;
    uint16_t sensor_h = 0;

    if ((w == 0) || (h == 0))
        return 1; // not valid

    _width = w;
    _height = h;

    if (_debug)
        debug.printf("W/H: %d/%d\n", w, h);

    uint8_t reg = 0;
    int ret = 0;
    // uint16_t w = resolution[framesize][0];
    // uint16_t h = resolution[framesize][1];

    // Not a multiple of 8. The JPEG encoder on the OV5640 can't handle this.
    if ((_format == JPEG) && ((w % 8) || (h % 8))) {
        if (_debug)
            debug.print("JPEG not multiple of 8: failed to set.......");
        return 1;
    }

    // Readout speed too fast. The DCMI_DMAConvCpltUser() line callback overhead
    // is too much to handle the line transfer speed. If we were to slow the
    // pixclk down these resolutions would work. As of right now, the image
    // shakes and scrolls with the current line transfer speed. Note that
    // there's an overhead to the DCMI_DMAConvCpltUser() function. It's not the
    // memory copy operation that's too slow. It's that there's too much
    // overhead in the DCMI_DMAConvCpltUser() method to even have time to start
    // the line transfer. If it were possible to slow the line readout speed of
    // the OV5640 this would enable these resolutions below. However, there's
    // nothing in the datasheet that when modified does this.
    // if (((_format == GRAYSCALE) || (_format == BAYER) || (_format == JPEG)))
    // {
    //    return 1;
    //}

    // Invalid resolution.
    if ((w > ACTIVE_SENSOR_WIDTH) || (h > ACTIVE_SENSOR_HEIGHT)) {
        return 1;
    }

    // Step 0: Clamp readout settings.

    readout_w = max(readout_w, w);
    readout_h = max(readout_h, h);

    int readout_x_max = (ACTIVE_SENSOR_WIDTH - readout_w) / 2;
    int readout_y_max = (ACTIVE_SENSOR_HEIGHT - readout_h) / 2;
    readout_x = max(min(readout_x, readout_x_max), -readout_x_max);
    readout_y = max(min(readout_y, readout_y_max), -readout_y_max);

    // Step 1: Determine readout area and subsampling amount.

    uint16_t sensor_div = 0;

    if ((w > (readout_w / 2)) || (h > (readout_h / 2))) {
        sensor_div = 1;
    } else {
        sensor_div = 2;
    }

    // Step 2: Determine horizontal and vertical start and end points.

    sensor_w = readout_w +
               DUMMY_WIDTH_BUFFER; // camera hardware needs dummy pixels to sync
    sensor_h = readout_h +
               DUMMY_HEIGHT_BUFFER; // camera hardware needs dummy lines to sync

    uint16_t sensor_ws =
        max(min((((ACTIVE_SENSOR_WIDTH - sensor_w) / 4) + (readout_x / 2)) * 2,
                ACTIVE_SENSOR_WIDTH - sensor_w),
            -(DUMMY_WIDTH_BUFFER / 2)) +
        DUMMY_COLUMNS; // must be multiple of 2
    uint16_t sensor_we = sensor_ws + sensor_w - 1;

    uint16_t sensor_hs =
        max(min((((ACTIVE_SENSOR_HEIGHT - sensor_h) / 4) - (readout_y / 2)) * 2,
                ACTIVE_SENSOR_HEIGHT - sensor_h),
            -(DUMMY_HEIGHT_BUFFER / 2)) +
        DUMMY_LINES; // must be multiple of 2
    uint16_t sensor_he = sensor_hs + sensor_h - 1;

    // Step 3: Determine scaling window offset.

    float ratio = min((readout_w / sensor_div) / ((float)w),
                      (readout_h / sensor_div) / ((float)h));

    uint16_t w_mul = w * ratio;
    uint16_t h_mul = h * ratio;
    uint16_t x_off = ((sensor_w / sensor_div) - w_mul) / 2;
    uint16_t y_off = ((sensor_h / sensor_div) - h_mul) / 2;

    // Step 4: Compute total frame time.

    hts_target = sensor_w / sensor_div;

    uint16_t sensor_hts = calculate_hts(w);
    uint16_t sensor_vts = calculate_vts(sensor_h / sensor_div);

    uint16_t sensor_x_inc =
        (((sensor_div * 2) - 1) << 4) |
        (1 << 0); // odd[7:4]/even[3:0] pixel inc on the bayer pattern
    uint16_t sensor_y_inc =
        (((sensor_div * 2) - 1) << 4) |
        (1 << 0); // odd[7:4]/even[3:0] pixel inc on the bayer pattern

    if (_debug) {
        debug.println("Setting FrameSize:");
        debug.println("  Step 0:");
        debug.printf("   readout_w: %d, readout_h: %d, readout_x_max: %d, "
                     "readout_x_max: %d\n",
                     readout_w, readout_h, readout_x_max, readout_y_max);
        debug.printf("   readout_x: %d, readout_y: %d\n", readout_x, readout_y);
        debug.println("  Step 1:");
        debug.printf("   sensor_div: %d\n", sensor_div);
        debug.println("  Step 2:");
        debug.printf(
            "  sensor_w: %d, sensor_h: %d, sensor_ws: %d, sensor_we: %d\n",
            sensor_w, sensor_h, sensor_ws, sensor_we);
        debug.printf("  sensor_hs: %d, sensor_hs: %d\n", sensor_hs, sensor_he);
        debug.printf("  Step 3:");
        debug.printf("  ratio: %f, w_mul: %d, h_mul: %d\n", ratio, w_mul,
                     h_mul);
        debug.printf("  x_off: %d, y_off: %d\n", x_off, y_off);
        debug.printf("  Step 4:");
        debug.printf("  hts_target: %d, sensor_hts: %d, sensor_vts: %d: %d\n",
                     hts_target, sensor_hts, sensor_vts);
        debug.printf("  sensor_x_inc: %d, sensor_x_inc:%d\n", sensor_x_inc,
                     sensor_x_inc);
    }

    // Step 5: Write regs.

    ret |= cameraWriteRegister(TIMING_HS_H, sensor_ws >> 8);
    ret |= cameraWriteRegister(TIMING_HS_L, sensor_ws);

    ret |= cameraWriteRegister(TIMING_VS_H, sensor_hs >> 8);
    ret |= cameraWriteRegister(TIMING_VS_L, sensor_hs);

    ret |= cameraWriteRegister(TIMING_HW_H, sensor_we >> 8);
    ret |= cameraWriteRegister(TIMING_HW_L, sensor_we);

    ret |= cameraWriteRegister(TIMING_VH_H, sensor_he >> 8);
    ret |= cameraWriteRegister(TIMING_VH_L, sensor_he);

    ret |= cameraWriteRegister(TIMING_DVPHO_H, w >> 8);
    ret |= cameraWriteRegister(TIMING_DVPHO_L, w);

    ret |= cameraWriteRegister(TIMING_DVPVO_H, h >> 8);
    ret |= cameraWriteRegister(TIMING_DVPVO_L, h);

    ret |= cameraWriteRegister(TIMING_HTS_H, sensor_hts >> 8);
    ret |= cameraWriteRegister(TIMING_HTS_L, sensor_hts);

    ret |= cameraWriteRegister(TIMING_VTS_H, sensor_vts >> 8);
    ret |= cameraWriteRegister(TIMING_VTS_L, sensor_vts);

    ret |= cameraWriteRegister(TIMING_HOFFSET_H, x_off >> 8);
    ret |= cameraWriteRegister(TIMING_HOFFSET_L, x_off);

    ret |= cameraWriteRegister(TIMING_VOFFSET_H, y_off >> 8);
    ret |= cameraWriteRegister(TIMING_VOFFSET_L, y_off);

    ret |= cameraWriteRegister(TIMING_X_INC, sensor_x_inc);
    ret |= cameraWriteRegister(TIMING_Y_INC, sensor_y_inc);

    ret |= cameraReadRegister(TIMING_TC_REG_20, reg);
    ret |=
        cameraWriteRegister(TIMING_TC_REG_20, (reg & 0xFE) | (sensor_div > 1));

    ret |= cameraReadRegister(TIMING_TC_REG_21, reg);
    ret |=
        cameraWriteRegister(TIMING_TC_REG_21, (reg & 0xFE) | (sensor_div > 1));

    ret |= cameraWriteRegister(VFIFO_HSIZE_H, w >> 8);
    ret |= cameraWriteRegister(VFIFO_HSIZE_L, w);

    ret |= cameraWriteRegister(VFIFO_VSIZE_H, h >> 8);
    ret |= cameraWriteRegister(VFIFO_VSIZE_L, h);

    return ret;
}

void OV5640::enableAutoFocus(bool useAF) {
    if (useAF == true) {
        _useAF = true;
    } else {
        _useAF = false;
    }
}

void OV5640::setContrast(int level) {
    int ret = 0;

    int new_level = level + (NUM_CONTRAST_LEVELS / 2);
    if (new_level < 0 || new_level >= NUM_CONTRAST_LEVELS) {
        new_level = 3;
    }

    ret |= cameraWriteRegister(0x3212, 0x03); // start group 3
    ret |= cameraWriteRegister(0x5586, (new_level + 5) << 2);
    ret |= cameraWriteRegister(0x5585, contrast_regs[new_level][0]);
    ret |= cameraWriteRegister(0x3212, 0x13); // end group 3
    ret |= cameraWriteRegister(0x3212, 0xa3); // launch group 3

    // return ret;
}

int OV5640::setBrightness(int level) {
    int ret = 0;

    int new_level = level + (NUM_BRIGHTNESS_LEVELS / 2);
    if (new_level < 0 || new_level >= NUM_BRIGHTNESS_LEVELS) {
        new_level = 5;
    }

    ret |= cameraWriteRegister(0x3212, 0x03); // start group 3
    ret |= cameraWriteRegister(0x5587, abs(new_level) << 4);
    ret |= cameraWriteRegister(0x5588, (new_level < 0) ? 0x09 : 0x01);
    ret |= cameraWriteRegister(0x3212, 0x13); // end group 3
    ret |= cameraWriteRegister(0x3212, 0xa3); // launch group 3

    return ret;
}

void OV5640::setSaturation(int level) {
    int ret = 0;

    int new_level = level + (NUM_SATURATION_LEVELS / 2);
    if (new_level < 0 || new_level >= NUM_SATURATION_LEVELS) {
        new_level = 5;
    }

    ret |= cameraWriteRegister(0x3212, 0x03); // start group 3
    ret |= cameraWriteRegister(0x5001, 0xFF);
    ret |= cameraWriteRegister(0x5583, saturation_regs[new_level][0]);
    ret |= cameraWriteRegister(0x5584, saturation_regs[new_level][1]);
    ret |= cameraWriteRegister(0x5580, 0x02);
    ret |= cameraWriteRegister(0x5588, 0x41);
    ret |= cameraWriteRegister(0x3212, 0x13); // end group 3
    ret |= cameraWriteRegister(0x3212, 0xa3); // launch group 3

    // return ret;
}

int OV5640::setGainceiling(gainceiling_t gainceiling) {
    uint8_t reg = 0;
    int ret = 0;

    int new_gainceiling = 16 << (gainceiling + 1);
    if (new_gainceiling >= 1024) {
        return 1;
    }

    ret |= cameraReadRegister(AEC_GAIN_CEILING_H, reg);
    ret |= cameraWriteRegister(AEC_GAIN_CEILING_H,
                               (reg & 0xFC) | (new_gainceiling >> 8));
    ret |= cameraWriteRegister(AEC_GAIN_CEILING_L, new_gainceiling);

    return ret;
}

int OV5640::setQuality(int qs) {
    uint8_t reg = 0;
    int ret = cameraReadRegister(JPEG_CTRL07, reg);
    ret |= cameraWriteRegister(JPEG_CTRL07, (reg & 0xC0) | (qs >> 2));

    return ret;
}

uint8_t OV5640::getQuality() {
    // int ret = 0;
    uint8_t reg = 0;

    /* Write QS register */
    cameraReadRegister(JPEG_CTRL07, reg);
    return reg;
}

int OV5640::setColorbar(int enable) {
    uint8_t reg = 0;
    int ret = cameraReadRegister(PRE_ISP_TEST, reg);
    return cameraWriteRegister(PRE_ISP_TEST,
                               (reg & 0x7F) | (enable ? 0x80 : 0x00)) |
           ret;
}

int OV5640::calc_pclk_freq(uint8_t sc_pll_ctrl_0, uint8_t sc_pll_ctrl_1,
                           uint8_t sc_pll_ctrl_2, uint8_t sc_pll_ctrl_3,
                           uint8_t sys_root_div) {
    uint32_t pclk_freq = _xclk_freq * 1000000;
    pclk_freq /= ((sc_pll_ctrl_3 & 0x10) != 0x00) ? 2 : 1;
    pclk_freq /= ((sc_pll_ctrl_0 & 0x0F) == 0x0A) ? 10 : 8;
    switch (sc_pll_ctrl_3 & 0x0F) {
    case 0:
        pclk_freq /= 1;
        break;
    case 1:
        pclk_freq /= 2;
        break;
    case 2:
        pclk_freq /= 3;
        break;
    case 3:
        pclk_freq /= 4;
        break;
    case 4:
        pclk_freq /= 6;
        break;
    case 5:
        pclk_freq /= 8;
        break;
    default:
        pclk_freq /= 3;
        break;
    }
    pclk_freq *= sc_pll_ctrl_2;
    sc_pll_ctrl_1 >>= 4;
    pclk_freq /= sc_pll_ctrl_1;
    switch (sys_root_div & 0x30) {
    case 0x00:
        pclk_freq /= 1;
        break;
    case 0x10:
        pclk_freq /= 2;
        break;
    case 0x20:
        pclk_freq /= 4;
        break;
    case 0x30:
        pclk_freq /= 8;
        break;
    default:
        pclk_freq /= 1;
        break;
    }
    return (int)pclk_freq;
}

int OV5640::setAutoExposure(int enable, int exposure_us) {
    uint8_t reg = 0;
    uint8_t spc0 = 0;
    uint8_t spc1 = 0;
    uint8_t spc2 = 0;
    uint8_t spc3 = 0;
    uint8_t sysrootdiv = 0;
    uint8_t hts_h = 0;
    uint8_t hts_l = 0;
    uint8_t vts_h = 0;
    uint8_t vts_l;

    int ret = cameraReadRegister(AEC_PK_MANUAL, reg);
    ret |=
        cameraWriteRegister(AEC_PK_MANUAL, (reg & 0xFE) | ((enable == 0) << 0));

    if ((enable == 0) && (exposure_us >= 0)) {
        ret |= cameraReadRegister(SC_PLL_CONTRL0, spc0);
        ret |= cameraReadRegister(SC_PLL_CONTRL1, spc1);
        ret |= cameraReadRegister(SC_PLL_CONTRL2, spc2);
        ret |= cameraReadRegister(SC_PLL_CONTRL3, spc3);
        ret |= cameraReadRegister(SYSTEM_ROOT_DIVIDER, sysrootdiv);

        ret |= cameraReadRegister(TIMING_HTS_H, hts_h);
        ret |= cameraReadRegister(TIMING_HTS_L, hts_l);

        ret |= cameraReadRegister(TIMING_VTS_H, vts_h);
        ret |= cameraReadRegister(TIMING_VTS_L, vts_l);

        uint16_t hts = (hts_h << 8) | hts_l;
        uint16_t vts = (vts_h << 8) | vts_l;

        int pclk_freq = calc_pclk_freq(spc0, spc1, spc2, spc3, sysrootdiv);
        int clocks_per_us = pclk_freq / 1000000;
        int exposure =
            max(min((exposure_us * clocks_per_us) / hts, 0xFFFF), 0x0000);

        int new_vts = max(exposure, vts);

        ret |= cameraWriteRegister(AEC_PK_EXPOSURE_0, exposure >> 12);
        ret |= cameraWriteRegister(AEC_PK_EXPOSURE_1, exposure >> 4);
        ret |= cameraWriteRegister(AEC_PK_EXPOSURE_2, exposure << 4);

        ret |= cameraWriteRegister(TIMING_VTS_H, new_vts >> 8);
        ret |= cameraWriteRegister(TIMING_VTS_L, new_vts);
    }

    return ret;
}

int OV5640::getExposure_us(int *exposure_us) {
    uint8_t spc0 = 0;
    uint8_t spc1 = 0;
    uint8_t spc2 = 0;
    uint8_t spc3 = 0;
    uint8_t sysrootdiv = 0;
    uint8_t hts_h = 0;
    uint8_t hts_l = 0;
    uint8_t vts_h = 0;
    uint8_t vts_l;
    uint8_t aec_0 = 0;
    uint8_t aec_1 = 0;
    uint8_t aec_2 = 0;
    int ret = 0;

    ret |= cameraReadRegister(SC_PLL_CONTRL0, spc0);
    ret |= cameraReadRegister(SC_PLL_CONTRL1, spc1);
    ret |= cameraReadRegister(SC_PLL_CONTRL2, spc2);
    ret |= cameraReadRegister(SC_PLL_CONTRL3, spc3);
    ret |= cameraReadRegister(SYSTEM_ROOT_DIVIDER, sysrootdiv);

    ret |= cameraReadRegister(AEC_PK_EXPOSURE_0, aec_0);
    ret |= cameraReadRegister(AEC_PK_EXPOSURE_1, aec_1);
    ret |= cameraReadRegister(AEC_PK_EXPOSURE_2, aec_2);

    ret |= cameraReadRegister(TIMING_HTS_H, hts_h);
    ret |= cameraReadRegister(TIMING_HTS_L, hts_l);

    ret |= cameraReadRegister(TIMING_VTS_H, vts_h);
    ret |= cameraReadRegister(TIMING_VTS_L, vts_l);

    uint32_t aec = ((aec_0 << 16) | (aec_1 << 8) | aec_2) >> 4;
    uint16_t hts = (hts_h << 8) | hts_l;
    uint16_t vts = (vts_h << 8) | vts_l;

    aec = min(aec, vts);

    int pclk_freq = calc_pclk_freq(spc0, spc1, spc2, spc3, sysrootdiv);
    int clocks_per_us = pclk_freq / 1000000;
    *exposure_us = (aec * hts) / clocks_per_us;

    return ret;
}

int OV5640::setAutoGain(int enable, float gain_db, float gain_db_ceiling) {
    uint8_t reg = 0;
    int ret = cameraReadRegister(AEC_PK_MANUAL, reg);
    ret |=
        cameraWriteRegister(AEC_PK_MANUAL, (reg & 0xFD) | ((enable == 0) << 1));

    if ((enable == 0) && (!isnanf(gain_db)) && (!isinff(gain_db))) {
        int gain = max(
            min(fast_roundf(expf((gain_db / 20.0f) * M_LN10) * 16.0f), 1023),
            0);

        ret |= cameraReadRegister(AEC_PK_REAL_GAIN_H, reg);
        ret |=
            cameraWriteRegister(AEC_PK_REAL_GAIN_H, (reg & 0xFC) | (gain >> 8));
        ret |= cameraWriteRegister(AEC_PK_REAL_GAIN_L, gain);
    } else if ((enable != 0) && (!isnanf(gain_db_ceiling)) &&
               (!isinff(gain_db_ceiling))) {
        int gain_ceiling = max(
            min(fast_roundf(expf((gain_db_ceiling / 20.0f) * M_LN10) * 16.0f),
                1023),
            0);

        ret |= cameraReadRegister(AEC_GAIN_CEILING_H, reg);
        ret |= cameraWriteRegister(AEC_GAIN_CEILING_H,
                                   (reg & 0xFC) | (gain_ceiling >> 8));
        ret |= cameraWriteRegister(AEC_GAIN_CEILING_L, gain_ceiling);
    }

    return ret;
}

int OV5640::getGain_db(float *gain_db) {
    uint8_t gainh = 0;
    uint8_t gainl = 0;

    int ret = cameraReadRegister(AEC_PK_REAL_GAIN_H, gainh);
    ret |= cameraReadRegister(AEC_PK_REAL_GAIN_L, gainl);

    *gain_db = 20.0f * log10f((((gainh & 0x3) << 8) | gainl) / 16.0f);

    return ret;
}

int OV5640::setAutoWhitebal(int enable, float r_gain_db, float g_gain_db,
                            float b_gain_db) {
    uint8_t reg = 0;
    int ret = cameraReadRegister(AWB_MANUAL_CONTROL, reg);
    ret |=
        cameraWriteRegister(AWB_MANUAL_CONTROL, (reg & 0xFE) | (enable == 0));

    if ((enable == 0) && (!isnanf(r_gain_db)) && (!isnanf(g_gain_db)) &&
        (!isnanf(b_gain_db)) && (!isinff(r_gain_db)) && (!isinff(g_gain_db)) &&
        (!isinff(b_gain_db))) {

        int r_gain =
            max(min(fast_roundf(expf((r_gain_db / 20.0f) * M_LN10)), 4095), 0);
        int g_gain =
            max(min(fast_roundf(expf((g_gain_db / 20.0f) * M_LN10)), 4095), 0);
        int b_gain =
            max(min(fast_roundf(expf((b_gain_db / 20.0f) * M_LN10)), 4095), 0);

        ret |= cameraWriteRegister(AWB_R_GAIN_H, r_gain >> 8);
        ret |= cameraWriteRegister(AWB_R_GAIN_L, r_gain);
        ret |= cameraWriteRegister(AWB_G_GAIN_H, g_gain >> 8);
        ret |= cameraWriteRegister(AWB_G_GAIN_L, g_gain);
        ret |= cameraWriteRegister(AWB_B_GAIN_H, b_gain >> 8);
        ret |= cameraWriteRegister(AWB_B_GAIN_L, b_gain);
    }

    return ret;
}

int OV5640::getRGB_Gain_db(float *r_gain_db, float *g_gain_db,
                           float *b_gain_db) {
    uint8_t redh = 0;
    uint8_t redl = 0;
    uint8_t greenh = 0;
    uint8_t greenl = 0;
    uint8_t blueh = 0;
    uint8_t bluel = 0;

    int ret = cameraReadRegister(AWB_R_GAIN_H, redh);
    ret |= cameraReadRegister(AWB_R_GAIN_L, redl);
    ret |= cameraReadRegister(AWB_G_GAIN_H, greenh);
    ret |= cameraReadRegister(AWB_G_GAIN_L, greenl);
    ret |= cameraReadRegister(AWB_B_GAIN_H, blueh);
    ret |= cameraReadRegister(AWB_B_GAIN_L, bluel);

    *r_gain_db = 20.0f * log10f(((redh & 0xF) << 8) | redl);
    *g_gain_db = 20.0f * log10f(((greenh & 0xF) << 8) | greenl);
    *b_gain_db = 20.0f * log10f(((blueh & 0xF) << 8) | bluel);

    return ret;
}

int OV5640::setHmirror(int enable) {
    uint8_t reg = 0;
    int ret = cameraReadRegister(TIMING_TC_REG_21, reg);
    if (enable) {
        ret |= cameraWriteRegister(TIMING_TC_REG_21, reg | 0x06);
    } else {
        ret |= cameraWriteRegister(TIMING_TC_REG_21, reg & 0xF9);
    }
    return ret;
}

int OV5640::setVflip(int enable) {
    uint8_t reg = 0;
    int ret = cameraReadRegister(TIMING_TC_REG_20, reg);
    if (!enable) {
        ret |= cameraWriteRegister(TIMING_TC_REG_20, reg | 0x06);
    } else {
        ret |= cameraWriteRegister(TIMING_TC_REG_20, reg & 0xF9);
    }
    return ret;
}

void OV5640::setHue(int hue) {
    int ret = 0;
    int new_level = hue + (NUM_HUE_LEVELS / 2);
    if (new_level < 0 || new_level >= NUM_HUE_LEVELS) {
        new_level = 6;
    }

    ret |= cameraWriteRegister(ISP_CONTROL_01, 0xFF);
    ret |= cameraWriteRegister(SDE_CTRL0, 0x01);
    ret |= cameraWriteRegister(SDE_CTRL6, hue_regs[new_level][0]);
    ret |= cameraWriteRegister(SDE_CTRL5, hue_regs[new_level][1]);
    ret |= cameraWriteRegister(SDE_CTRL2, hue_regs[new_level][2]);
    ret |= cameraWriteRegister(SDE_CTRL8, 0xA3);

    if (ret < 0)
        debug.printf("HUE NOT SET!!!");
}

/*  Functions specific to the OV5640 */
int OV5640::setWBmode(int mode) {
    int ret = 0;
    if (mode < 0 || mode > NUM_WB_MODES) {
        ret |= cameraWriteRegister(0x3212, 0x03); // start group 3
        ret |= cameraWriteRegister(0x3406, wb_modes_regs[0][0]);
        ret |= cameraWriteRegister(0x3400, wb_modes_regs[0][1]);
        ret |= cameraWriteRegister(0x3401, wb_modes_regs[0][2]);
        ret |= cameraWriteRegister(0x3402, wb_modes_regs[0][3]);
        ret |= cameraWriteRegister(0x3403, wb_modes_regs[0][4]);
        ret |= cameraWriteRegister(0x3404, wb_modes_regs[0][5]);
        ret |= cameraWriteRegister(0x3405, wb_modes_regs[0][6]);
        ret |= cameraWriteRegister(0x3212, 0x13); // end group 3
        ret |= cameraWriteRegister(0x3212, 0xa3); // lanuch group 3
        return 1;
    }

    ret |= cameraWriteRegister(0x3212, 0x03); // start group 3
    ret |= cameraWriteRegister(0x3406, wb_modes_regs[mode][0]);
    ret |= cameraWriteRegister(0x3400, wb_modes_regs[mode][1]);
    ret |= cameraWriteRegister(0x3401, wb_modes_regs[mode][2]);
    ret |= cameraWriteRegister(0x3402, wb_modes_regs[mode][3]);
    ret |= cameraWriteRegister(0x3403, wb_modes_regs[mode][4]);
    ret |= cameraWriteRegister(0x3404, wb_modes_regs[mode][5]);
    ret |= cameraWriteRegister(0x3405, wb_modes_regs[mode][6]);
    ret |= cameraWriteRegister(0x3212, 0x13); // end group 3
    ret |= cameraWriteRegister(0x3212, 0xa3); // lanuch group 3

    return ret;
}

int OV5640::setSpecialEffect(sde_t sde) {
    int ret = 0;
    int effect = 0;

    effect = sde;
    if (effect < 0 || effect > NUM_SPECIAL_EFFECTS) {
        return 1;
    }

    ret |= cameraWriteRegister(0x3212, 0x03); // start group 3
    ret |= cameraWriteRegister(0x5580, special_effects_regs[effect][0]);
    ret |=
        cameraWriteRegister(0x5583, special_effects_regs[effect][1]); // sat U
    ret |=
        cameraWriteRegister(0x5584, special_effects_regs[effect][2]); // sat V
    ret |= cameraWriteRegister(0x5003, special_effects_regs[effect][3]);
    ret |= cameraWriteRegister(0x3212, 0x13); // end group 3
    ret |= cameraWriteRegister(0x3212, 0xa3); // launch group 3

    return ret;
}

int OV5640::setAutoBlc(int enable, int *regs) {
    uint8_t reg = 0;
    int ret = cameraReadRegister(BLC_CTRL_00, reg);
    ret |= cameraWriteRegister(BLC_CTRL_00, (reg & 0xFE) | (enable != 0));

    if ((enable == 0) && (regs != NULL)) {
        for (uint32_t i = 0; i < 8; i++) {
            ret |= cameraWriteRegister(BLACK_LEVEL_00_H + i, regs[i]);
        }
    }

    return ret;
}

int OV5640::getBlcRegs(int *regs) {
    int ret = 0;

    for (uint32_t i = 0; i < 8; i++) {
        uint8_t reg = 0;
        ret |= cameraReadRegister(BLACK_LEVEL_00_H + i, reg);
        regs[i] = reg;
    }

    return ret;
}

int OV5640::setLensCorrection(int enable) {
    uint8_t reg;
    int ret = cameraReadRegister(ISP_CONTROL_00, reg);
    return cameraWriteRegister(ISP_CONTROL_00,
                               (reg & 0x7F) | (enable ? 0x80 : 0x00)) |
           ret;
}

int OV5640::setNightMode(int enable) {
    /* read HTS from register settings */
    uint8_t reg = 0;
    int ret = 0;
    if (enable) {
        ret = cameraReadRegister(AEC_CTRL_00, reg);
        if (ret)
            return ret;
        reg &= 0xfb;
        return cameraWriteRegister(AEC_CTRL_00, reg);
    } else {
        return cameraWriteRegister(AEC_CTRL_00, aecCtrl00_old);
    }
    return 0;
}

int OV5640::setSharpness(int level) {
    int ret = 0;

    if (level < 0 || level > NUM_SHARPNESS_LEVELS) {
        return 1;
    }

    ret |= cameraWriteRegister(CIP_CTRL, 0x65);
    ret |= cameraWriteRegister(CIP_SHARPENMT_OFFSET1, sharpness_regs[level][0]);

    return ret;
}

int OV5640::setAutoSharpness(int enable) {
    int ret = 0;

    if (enable) {
        ret |= cameraWriteRegister(CIP_CTRL, 0x25);
        ret |= cameraWriteRegister(CIP_SHARPENMT_THRESH1, 0x08);
        ret |= cameraWriteRegister(CIP_SHARPENMT_THRESH2, 0x30);
        ret |= cameraWriteRegister(CIP_SHARPENMT_OFFSET1, 0x10);
        ret |= cameraWriteRegister(CIP_SHARPENMT_OFFSET1, 0x00);
        ret |= cameraWriteRegister(CIP_SHARPENTH_THRESH1, 0x08);
        ret |= cameraWriteRegister(CIP_SHARPENTH_THRESH2, 0x30);
        ret |= cameraWriteRegister(CIP_SHARPENTH_OFFSET1, 0x04);
        ret |= cameraWriteRegister(CIP_SHARPENTH_OFFSET2, 0x06);
    } else {
        ret |= cameraWriteRegister(CIP_CTRL, 0x25);
        ret |= cameraWriteRegister(CIP_SHARPENMT_THRESH1, 0x08);
        ret |= cameraWriteRegister(CIP_SHARPENMT_THRESH2, 0x48);
        ret |= cameraWriteRegister(CIP_SHARPENMT_OFFSET1, 0x18);
        ret |= cameraWriteRegister(CIP_SHARPENMT_OFFSET1, 0x0E);
        ret |= cameraWriteRegister(CIP_SHARPENTH_THRESH1, 0x08);
        ret |= cameraWriteRegister(CIP_SHARPENTH_THRESH2, 0x48);
        ret |= cameraWriteRegister(CIP_SHARPENTH_OFFSET1, 0x04);
        ret |= cameraWriteRegister(CIP_SHARPENTH_OFFSET2, 0x06);
    }

    return ret;
}

/*******************************************************************/

#define FLEXIO_USE_DMA

uint8_t OV5640::setAutoFocusMode() {

    uint8_t ret = 0;

    ret = cameraWriteRegister(OV5640_CMD_MAIN, 0x01);
    ret |= cameraWriteRegister(OV5640_CMD_MAIN, 0x08);
    checkAFCmdStatus(OV5640_CMD_ACK, 0);

    ret |= cameraWriteRegister(OV5640_CMD_ACK, 0x01);
    ret |= cameraWriteRegister(OV5640_CMD_MAIN, AF_CONTINUE_AUTO_FOCUS);
    checkAFCmdStatus(OV5640_CMD_ACK, 0);

    return ret;
}

size_t OV5640::readFrameGPIO_JPEG(void *buffer, size_t cb1, void *buffer2,
                                  size_t cb2) {
    uint16_t w = _width;
    uint16_t h = _height;
    uint32_t i_count = 0;

    debug.printf("$$readFrameGPIO_JPEG(%p, %u, %p, %u)\n", buffer, cb1, buffer2,
                 cb2);
    const uint32_t frame_size_bytes = w * h * _bytesPerPixel / 5;
    if ((cb1 + cb2) < frame_size_bytes) {
        if (_debug)
            debug.printf("Warning Buffers may be too small for JPEG %u < %u\n",
                         cb1 + cb2, frame_size_bytes);
    }
    DBGdigitalWriteFast(0, HIGH);
    uint8_t *b = (uint8_t *)buffer;
    uint32_t cb = (uint32_t)cb1;
    //  bool _grayscale;  // ????  member variable ?????????????
    int bytesPerRow = _width * _bytesPerPixel;

    // Falling edge indicates start of frame
    // pinMode(PCLK_PIN, INPUT); // make sure back to input pin...
    // lets add our own glitch filter.  Say it must be hig for at least 100us
    elapsedMicros emHigh;
    DBGdigitalWriteFast(0, LOW);
    do {
        while ((*_vsyncPort & _vsyncMask) == 0)
            ; // wait for HIGH
        emHigh = 0;
        while ((*_vsyncPort & _vsyncMask) != 0)
            ; // wait for LOW
    } while (emHigh < 1);

    // uint8_t *pu8 = (uint8_t *)b;
    uint8_t prev_char = 0;

    DBGdigitalWriteFast(0, HIGH);
    for (int i = 0; i < h; i++) {
        // rising edge indicates start of line
        while ((*_hrefPort & _hrefMask) == 0)
            ; // wait for HIGH
        while ((*_pclkPort & _pclkMask) != 0)
            ; // wait for LOW
        noInterrupts();

        for (int j = 0; j < bytesPerRow; j++) {
            // rising edges clock each data byte
            while ((*_pclkPort & _pclkMask) == 0)
                ; // wait for HIGH

            // uint32_t in = ((_frame_buffer_pointer)? GPIO1_DR : GPIO6_DR) >>
            // 18; // read all bits in parallel
            uint32_t in = (GPIO7_PSR >> 4); // read all bits in parallel

            // uint32_t in = mmBus;
            // bugbug what happens to the the data if grayscale?
            if (!(j & 1) || !_grayscale) {
                *b++ = in;
                cb--;
                if (cb == 0) {
                    if (buffer2) {
                        if (_debug)
                            debug.printf("\t$$ 2nd buffer: %u %u\n", i, j);
                        b = (uint8_t *)buffer2;
                        cb = (uint32_t)cb2;
                        buffer2 = nullptr;
                    } else {
                        if (_debug)
                            debug.printf("Error failed buffers too small\n");
                        interrupts();
                        DBGdigitalWriteFast(0, LOW);
                        return frame_size_bytes;
                    }
                }
            }

            if ((prev_char == 0xff) && ((uint8_t)in == 0xd9)) {
                interrupts();
                DBGdigitalWriteFast(0, LOW);
                return i_count + 1;
            }
            prev_char = (uint8_t)in;
            i_count = i_count + 1;

            while (((*_pclkPort & _pclkMask) != 0) &&
                   ((*_hrefPort & _hrefMask) != 0))
                ; // wait for LOW bail if _href is lost
        }

        while ((*_hrefPort & _hrefMask) != 0)
            ; // wait for LOW
        interrupts();
    }
    DBGdigitalWriteFast(0, LOW);

    return frame_size_bytes;
}

/*********************************************************************/

//======================================== DMA JUNK
//================================================================================
// experiment with DMA
//================================================================================
// Define our DMA structure.
DMAChannel OV5640::_dmachannel;
DMASetting OV5640::_dmasettings[10];
uint32_t OV5640::_dmaBuffer1[DMABUFFER_SIZE] __attribute__((used, aligned(32)));
uint32_t OV5640::_dmaBuffer2[DMABUFFER_SIZE] __attribute__((used, aligned(32)));
extern "C" void xbar_connect(unsigned int input,
                             unsigned int output); // in pwm.c

// OV2640 *OV5640::active_dma_camera = nullptr;

//===================================================================
// Start a DMA operation -
//===================================================================
#if 0 // def later
bool OV5640::startReadFrameDMA(bool(*callback)(void *frame_buffer), uint8_t *fb1, uint8_t *fb2) {return false;}
bool OV5640::stopReadFrameDMA() {return false;}

#else
bool OV5640::startReadFrameDMA(bool (*callback)(void *frame_buffer),
                               uint8_t *fb1, uint8_t *fb2) {
    // First see if we need to allocate frame buffers.
    if (fb1)
        _frame_buffer_1 = fb1;
    else if (_frame_buffer_1 == nullptr) {
        _frame_buffer_1 = (uint8_t *)malloc(_width * _height);
        if (_frame_buffer_1 == nullptr)
            return false;
    }
    if (fb2)
        _frame_buffer_2 = fb2;
    else if (_frame_buffer_2 == nullptr) {
        _frame_buffer_2 = (uint8_t *)malloc(_width * _height);
        if (_frame_buffer_2 == nullptr)
            return false; // BUGBUG should we 32 byte align?
    }
    // remember the call back if passed in
    _callback = callback;
    active_dma_camera = this;

    if (_debug)
        debug.printf("startReadFrameDMA called buffers %x %x\n",
                     (uint32_t)_frame_buffer_1, (uint32_t)_frame_buffer_2);

    // DebugDigitalToggle(OV7670_DEBUG_PIN_1);
    // lets figure out how many bytes we will tranfer per setting...
    //  _dmasettings[0].begin();
    _frame_row_buffer_pointer = _frame_buffer_pointer =
        (uint8_t *)_frame_buffer_1;

    // configure DMA channels
    _dmachannel.begin();
    _dmasettings[0].source(GPIO2_PSR); // setup source.
    _dmasettings[0].destinationBuffer(
        _dmaBuffer1, DMABUFFER_SIZE * 4); // 32 bits per logical byte
    _dmasettings[0].replaceSettingsOnCompletion(_dmasettings[1]);
    _dmasettings[0]
        .interruptAtCompletion(); // we will need an interrupt to process this.
    _dmasettings[0].TCD->CSR &=
        ~(DMA_TCD_CSR_DREQ); // Don't disable on this one
    // DebugDigitalToggle(OV7670_DEBUG_PIN_1);

    _dmasettings[1].source(GPIO2_PSR); // setup source.
    _dmasettings[1].destinationBuffer(
        _dmaBuffer2, DMABUFFER_SIZE * 4); // 32 bits per logical byte
    _dmasettings[1].replaceSettingsOnCompletion(_dmasettings[0]);
    _dmasettings[1]
        .interruptAtCompletion(); // we will need an interrupt to process this.
    _dmasettings[1].TCD->CSR &=
        ~(DMA_TCD_CSR_DREQ); // Don't disable on this one
    // DebugDigitalToggle(OV7670_DEBUG_PIN_1);

    GPIO2_GDIR = 0; // set all as input...
    GPIO2_DR = 0;   // see if I can clear it out...

    _dmachannel = _dmasettings[0]; // setup the first on...
    _dmachannel.attachInterrupt(dmaInterrupt);
    _dmachannel.triggerAtHardwareEvent(DMAMUX_SOURCE_XBAR1_0);
    // DebugDigitalToggle(OV7670_DEBUG_PIN_1);

    // Lets try to setup the DMA setup...
    // first see if we can convert the _pclk to be an XBAR Input pin...
    // OV7670_PLK   4
    // OV7670_PLK   8    //8       B1_00   FlexIO2:16  XBAR IO14

    _save_pclkPin_portConfigRegister = *(portConfigRegister(_pclkPin));
    *(portConfigRegister(_pclkPin)) = 1; // set to XBAR mode 14

    // route the timer outputs through XBAR to edge trigger DMA request
    CCM_CCGR2 |= CCM_CCGR2_XBAR1(CCM_CCGR_ON);
    xbar_connect(XBARA1_IN_IOMUX_XBAR_INOUT14, XBARA1_OUT_DMA_CH_MUX_REQ30);
    // DebugDigitalToggle(OV7670_DEBUG_PIN_1);

    // Tell XBAR to dDMA on Rising
    XBARA1_CTRL0 = XBARA_CTRL_STS0 | XBARA_CTRL_EDGE0(1) |
                   XBARA_CTRL_DEN0 /* | XBARA_CTRL_IEN0 */;

    IOMUXC_GPR_GPR6 &=
        ~(IOMUXC_GPR_GPR6_IOMUXC_XBAR_DIR_SEL_14); // Make sure it is input mode
    IOMUXC_XBAR1_IN14_SELECT_INPUT =
        1; // Make sure this signal goes to this pin...

#if defined(ARDUINO_TEENSY_MICROMOD)
    // Need to switch the IO pins back to GPI1 from GPIO6
    _save_IOMUXC_GPR_GPR27 =
        IOMUXC_GPR_GPR27; // save away the configuration before we change...
    IOMUXC_GPR_GPR27 &= ~(0x0ff0u);

    // lets also un map the _hrefPin to GPIO1
    IOMUXC_GPR_GPR27 &= ~_hrefMask; //
#else
    // Need to switch the IO pins back to GPI1 from GPIO6
    _save_IOMUXC_GPR_GPR26 =
        IOMUXC_GPR_GPR26; // save away the configuration before we change...
    IOMUXC_GPR_GPR26 &= ~(0x0ff0u);

    // lets also un map the _hrefPin to GPIO1
    IOMUXC_GPR_GPR26 &= ~_hrefMask; //
#endif

    // Need to switch the IO pins back to GPI1 from GPIO6
    //_save_IOMUXC_GPR_GPR27 = IOMUXC_GPR_GPR27;  // save away the configuration
    // before we change... IOMUXC_GPR_GPR27 &= ~(0x0ff0u);

    // lets also un map the _hrefPin to GPIO1
    // IOMUXC_GPR_GPR27 &= ~_hrefMask; //

    // DebugDigitalToggle(OV7670_DEBUG_PIN_1);

    // Falling edge indicates start of frame
    //  while ((*_vsyncPort & _vsyncMask) == 0); // wait for HIGH
    //  while ((*_vsyncPort & _vsyncMask) != 0); // wait for LOW
    //  DebugDigitalWrite(OV7670_DEBUG_PIN_2, HIGH);

    // Debug stuff for now

    // We have the start of a frame, so lets start the dma.
#ifdef DEBUG_CAMERA
    dumpDMA_TCD(&_dmachannel, " CH: ");
    dumpDMA_TCD(&_dmasettings[0], " 0: ");
    dumpDMA_TCD(&_dmasettings[1], " 1: ");

    debug.printf("pclk pin: %d config:%lx control:%lx\n", _pclkPin,
                 *(portConfigRegister(_pclkPin)),
                 *(portControlRegister(_pclkPin)));
    debug.printf("IOMUXC_GPR_GPR26-29:%lx %lx %lx %lx\n", IOMUXC_GPR_GPR26,
                 IOMUXC_GPR_GPR27, IOMUXC_GPR_GPR28, IOMUXC_GPR_GPR29);
    debug.printf("GPIO1: %lx %lx, GPIO6: %lx %lx\n", GPIO1_DR, GPIO1_PSR,
                 GPIO6_DR, GPIO6_PSR);
    debug.printf("XBAR CTRL0:%x CTRL1:%x\n\n", XBARA1_CTRL0, XBARA1_CTRL1);
#endif
    _dma_state = DMASTATE_RUNNING;
    _dma_last_completed_frame = nullptr;
    _dma_frame_count = 0;

    // Now start an interrupt for start of frame.
    //  attachInterrupt(_vsyncPin, &frameStartInterrupt, RISING);

    // DebugDigitalToggle(OV7670_DEBUG_PIN_1);
    return true;
}

//===================================================================
// stopReadFrameDMA - stop doing the reading and then exit.
//===================================================================
bool OV5640::stopReadFrameDMA() {

// hopefully it start here (fingers crossed)
// for now will hang here to see if completes...
#ifdef OV7670_USE_DEBUG_PINS
// DebugDigitalWrite(OV7670_DEBUG_PIN_2, HIGH);
#endif
    elapsedMillis em = 0;
    // tell the background stuff DMA stuff to exit.
    // Note: for now let it end on on, later could disable the DMA directly.
    _dma_state = DMASTATE_STOP_REQUESTED;

    while ((em < 1000) && (_dma_state == DMASTATE_STOP_REQUESTED))
        ; // wait up to a second...
    if (_dma_state != DMA_STATE_STOPPED) {
        debug.println("*** stopReadFrameDMA DMA did not exit correctly...");
        debug.printf("  Bytes Left: %u frame buffer:%x Row:%u Col:%u\n",
                     _bytes_left_dma, (uint32_t)_frame_buffer_pointer,
                     _frame_row_index, _frame_col_index);
    }
#ifdef OV7670_USE_DEBUG_PINS
// DebugDigitalWrite(OV7670_DEBUG_PIN_2, LOW);
#endif
#ifdef DEBUG_CAMERA
    dumpDMA_TCD(&_dmachannel, nullptr);
    dumpDMA_TCD(&_dmasettings[0], nullptr);
    dumpDMA_TCD(&_dmasettings[1], nullptr);
    debug.println();
#endif
    // Lets restore some hardware pieces back to the way we found them.
#if defined(ARDUINO_TEENSY_MICROMOD)
    IOMUXC_GPR_GPR27 =
        _save_IOMUXC_GPR_GPR27; // Restore... away the configuration before we
                                // change...
#else
    IOMUXC_GPR_GPR26 =
        _save_IOMUXC_GPR_GPR26; // Restore... away the configuration before we
                                // change...
#endif
    *(portConfigRegister(_pclkPin)) = _save_pclkPin_portConfigRegister;

    return (em < 1000); // did we stop...
}

//===================================================================
// Our Frame Start interrupt.
//===================================================================
#if 0
void  OV5640::frameStartInterrupt() {
  active_dma_camera->processFrameStartInterrupt();  // lets get back to the main object...
}

void  OV5640::processFrameStartInterrupt() {
  _bytes_left_dma = (_width + _frame_ignore_cols) * _height; // for now assuming color 565 image...
  _dma_index = 0;
  _frame_col_index = 0;  // which column we are in a row
  _frame_row_index = 0;  // which row
  _save_lsb = 0xffff;
  // make sure our DMA is setup properly again. 
  _dmasettings[0].transferCount(DMABUFFER_SIZE);
  _dmasettings[0].TCD->CSR &= ~(DMA_TCD_CSR_DREQ); // Don't disable on this one
  _dmasettings[1].transferCount(DMABUFFER_SIZE);
  _dmasettings[1].TCD->CSR &= ~(DMA_TCD_CSR_DREQ); // Don't disable on this one
  _dmachannel = _dmasettings[0];  // setup the first on...
  _dmachannel.enable();
  
  detachInterrupt(_vsyncPin);
}
#endif

//===================================================================
// Our DMA interrupt.
//===================================================================
void OV5640::dmaInterrupt() {
    active_dma_camera
        ->processDMAInterrupt(); // lets get back to the main object...
}

// This version assumes only called when HREF...  as set pixclk to only fire
// when set.
void OV5640::processDMAInterrupt() {
    _dmachannel.clearInterrupt(); // tell system we processed it.
    asm("DSB");
#ifdef USE_DEBUG_PINS
// DebugDigitalWrite(OV7670_DEBUG_PIN_3, HIGH);
#endif

    if (_dma_state == DMA_STATE_STOPPED) {
        debug.println("OV5640::dmaInterrupt called when DMA_STATE_STOPPED");
        return; //
    }

    // lets guess which buffer completed.
    uint32_t *buffer;
    uint16_t buffer_size;
    _dma_index++;
    if (_dma_index & 1) {
        buffer = _dmaBuffer1;
        buffer_size = _dmasettings[0].TCD->CITER;

    } else {
        buffer = _dmaBuffer2;
        buffer_size = _dmasettings[1].TCD->CITER;
    }
    // lets try dumping a little data on 1st 2nd and last buffer.
#ifdef DEBUG_CAMERA_VERBOSE
    if ((_dma_index < 3) || (buffer_size < DMABUFFER_SIZE)) {
        debug.printf("D(%d, %d, %lu) %u : ", _dma_index, buffer_size,
                     _bytes_left_dma, pixformat);
        for (uint16_t i = 0; i < 8; i++) {
            uint16_t b = buffer[i] >> 4;
            debug.printf(" %lx(%02x)", buffer[i], b);
        }
        debug.print("...");
        for (uint16_t i = buffer_size - 8; i < buffer_size; i++) {
            uint16_t b = buffer[i] >> 4;
            debug.printf(" %lx(%02x)", buffer[i], b);
        }
        debug.println();
    }
#endif

    for (uint16_t buffer_index = 0; buffer_index < buffer_size;
         buffer_index++) {
        if (!_bytes_left_dma || (_frame_row_index >= _height))
            break;

        // only process if href high...
        uint16_t b = *buffer >> 4;
        *_frame_buffer_pointer++ = b;
        _frame_col_index++;
        if (_frame_col_index == _width) {
            // we just finished a row.
            _frame_row_index++;
            _frame_col_index = 0;
        }
        _bytes_left_dma--; // for now assuming color 565 image...
        buffer++;
    }

    if ((_frame_row_index == _height) ||
        (_bytes_left_dma == 0)) { // We finished a frame lets bail
        _dmachannel.disable();    // disable the DMA now...
#ifdef USE_DEBUG_PINS
// DebugDigitalWrite(OV7670_DEBUG_PIN_2, LOW);
#endif
#ifdef DEBUG_CAMERA_VERBOSE
        debug.println("EOF");
#endif
        _frame_row_index = 0;
        _dma_frame_count++;

        bool swap_buffers = true;

        // DebugDigitalToggle(OV7670_DEBUG_PIN_1);
        _dma_last_completed_frame = _frame_row_buffer_pointer;
        if (_callback)
            swap_buffers = (*_callback)(_dma_last_completed_frame);

        if (swap_buffers) {
            if (_frame_row_buffer_pointer != _frame_buffer_1)
                _frame_row_buffer_pointer = _frame_buffer_2;
            else
                _frame_row_buffer_pointer = _frame_buffer_2;
        }

        _frame_buffer_pointer = _frame_row_buffer_pointer;

        // DebugDigitalToggle(OV7670_DEBUG_PIN_1);

        if (_dma_state == DMASTATE_STOP_REQUESTED) {
#ifdef DEBUG_CAMERA
            debug.println("OV5640::dmaInterrupt - Stop requested");
#endif
            _dma_state = DMA_STATE_STOPPED;
        } else {
            // We need to start up our ISR for the next frame.
#if 1
            // bypass interrupt and just restart DMA...
            _bytes_left_dma = (_width + _frame_ignore_cols) *
                              _height; // for now assuming color 565 image...
            _dma_index = 0;
            _frame_col_index = 0; // which column we are in a row
            _frame_row_index = 0; // which row
            _save_lsb = 0xffff;
            // make sure our DMA is setup properly again.
            _dmasettings[0].transferCount(DMABUFFER_SIZE);
            _dmasettings[0].TCD->CSR &=
                ~(DMA_TCD_CSR_DREQ); // Don't disable on this one
            _dmasettings[1].transferCount(DMABUFFER_SIZE);
            _dmasettings[1].TCD->CSR &=
                ~(DMA_TCD_CSR_DREQ);       // Don't disable on this one
            _dmachannel = _dmasettings[0]; // setup the first on...
            _dmachannel.enable();

#else
            attachInterrupt(_vsyncPin, &frameStartInterrupt, RISING);
#endif
        }
    } else {

        if (_bytes_left_dma == (2 * DMABUFFER_SIZE)) {
            if (_dma_index & 1)
                _dmasettings[0].disableOnCompletion();
            else
                _dmasettings[1].disableOnCompletion();
        }
    }
#ifdef OV7670_USE_DEBUG_PINS
// DebugDigitalWrite(OV7670_DEBUG_PIN_3, LOW);
#endif
}

#endif // LATER
typedef struct {
    uint32_t frameTimeMicros;
    uint16_t vsyncStartCycleCount;
    uint16_t vsyncEndCycleCount;
    uint16_t hrefCount;
    uint32_t cycleCount;
    uint16_t pclkCounts[350]; // room to spare.
    uint32_t hrefStartTime[350];
    uint16_t pclkNoHrefCount;
} frameStatics_t;

frameStatics_t fstatOmni40;

void OV5640::captureFrameStatistics() {
    memset((void *)&fstatOmni40, 0, sizeof(fstatOmni40));

    // lets wait for the vsync to go high;
    while ((*_vsyncPort & _vsyncMask) != 0)
        ; // wait for HIGH
    // now lets wait for it to go low
    while ((*_vsyncPort & _vsyncMask) == 0)
        fstatOmni40.vsyncStartCycleCount++; // wait for LOW

    while ((*_hrefPort & _hrefMask) == 0)
        ; // wait for HIGH
    while ((*_pclkPort & _pclkMask) != 0)
        ; // wait for LOW

    uint32_t microsStart = micros();
    fstatOmni40.hrefStartTime[0] = microsStart;
    // now loop through until we get the next _vsynd
    // BUGBUG We know that HSYNC and PCLK on same GPIO VSYNC is not...
    uint32_t regs_prev = 0;
    // noInterrupts();
    while ((*_vsyncPort & _vsyncMask) != 0) {

        fstatOmni40.cycleCount++;
        uint32_t regs = (*_hrefPort & (_hrefMask | _pclkMask));
        if (regs != regs_prev) {
            if ((regs & _hrefMask) && ((regs_prev & _hrefMask) == 0)) {
                fstatOmni40.hrefCount++;
                fstatOmni40.hrefStartTime[fstatOmni40.hrefCount] = micros();
            }
            if ((regs & _pclkMask) && ((regs_prev & _pclkMask) == 0))
                fstatOmni40.pclkCounts[fstatOmni40.hrefCount]++;
            if ((regs & _pclkMask) && ((regs_prev & _hrefMask) == 0))
                fstatOmni40.pclkNoHrefCount++;
            regs_prev = regs;
        }
    }
    while ((*_vsyncPort & _vsyncMask) == 0)
        fstatOmni40.vsyncEndCycleCount++; // wait for LOW
    // interrupts();
    fstatOmni40.frameTimeMicros = micros() - microsStart;

    // Maybe return data. print now
    debug.printf("*** Frame Capture Data: elapsed Micros: %u loops: %u\n",
                 fstatOmni40.frameTimeMicros, fstatOmni40.cycleCount);
    debug.printf("   VSync Loops Start: %u end: %u\n",
                 fstatOmni40.vsyncStartCycleCount,
                 fstatOmni40.vsyncEndCycleCount);
    debug.printf("   href count: %u pclk ! href count: %u\n    ",
                 fstatOmni40.hrefCount, fstatOmni40.pclkNoHrefCount);
    for (uint16_t ii = 0; ii < fstatOmni40.hrefCount + 1; ii++) {
        debug.printf("%3u(%u) ", fstatOmni40.pclkCounts[ii],
                     (ii == 0) ? 0
                               : fstatOmni40.hrefStartTime[ii] -
                                     fstatOmni40.hrefStartTime[ii - 1]);
        if (!(ii & 0x0f))
            debug.print("\n    ");
    }
    debug.println();
}

/*****************************************************************/

typedef struct {
    const __FlashStringHelper *reg_name;
    uint16_t reg;
} OV5640_TO_NAME_t;

static const OV5640_TO_NAME_t OV5640_reg_name_table[] PROGMEM{
    {F("SYSTEM_CTROL0"), 0x3008},
    {F("DRIVE_CAPABILITY"), 0x302c},
    {F("SC_PLLS_CTRL0"), 0x303a},
    {F("SC_PLLS_CTRL1"), 0x303b},
    {F("SC_PLLS_CTRL2"), 0x303c},
    {F("SC_PLLS_CTRL3"), 0x303d},
    {F("AEC_PK_MANUAL"), 0x3503},
    {F("X_ADDR_ST_H"), 0x3800},
    {F("X_ADDR_ST_L"), 0x3801},
    {F("Y_ADDR_ST_H"), 0x3802},
    {F("Y_ADDR_ST_L"), 0x3803},
    {F("X_ADDR_END_H"), 0x3804},
    {F("X_ADDR_END_L"), 0x3805},
    {F("Y_ADDR_END_H"), 0x3806},
    {F("Y_ADDR_END_L"), 0x3807},
    {F("X_OUTPUT_SIZE_H"), 0x3808},
    {F("X_OUTPUT_SIZE_L"), 0x3809},
    {F("Y_OUTPUT_SIZE_H"), 0x380a},
    {F("Y_OUTPUT_SIZE_L"), 0x380b},
    {F("X_TOTAL_SIZE_H"), 0x380c},
    {F("X_TOTAL_SIZE_L"), 0x380d},
    {F("Y_TOTAL_SIZE_H"), 0x380e},
    {F("Y_TOTAL_SIZE_L"), 0x380f},
    {F("X_OFFSET_H"), 0x3810},
    {F("X_OFFSET_L"), 0x3811},
    {F("Y_OFFSET_H"), 0x3812},
    {F("Y_OFFSET_L"), 0x3813},
    {F("X_INCREMENT"), 0x3814},
    {F("Y_INCREMENT"), 0x3815},
    {F("TIMING_TC_REG20"), 0x3820},
    {F("TIMING_TC_REG21"), 0x3821},
    {F("PCLK_RATIO"), 0x3824},
    {F("FRAME_CTRL01"), 0x4201},
    {F("FRAME_CTRL02"), 0x4202},
    {F("FORMAT_CTRL00"), 0x4300},
    {F("CLOCK_POL_CONTROL"), 0x4740},
    {F("ISP_CONTROL_01"), 0x5001},
    {F("FORMAT_CTRL"), 0x501F},
    {F("PRE_ISP_TEST_SETTING_1"), 0x503D},
    {F("SCALE_CTRL_1"), 0x5601},
    {F("SCALE_CTRL_2"), 0x5602},
    {F("SCALE_CTRL_3"), 0x5603},
    {F("SCALE_CTRL_4"), 0x5604},
    {F("SCALE_CTRL_5"), 0x5605},
    {F("SCALE_CTRL_6"), 0x5606},
    {F("X_START_H"), 0x5680},
    {F("X_START_L"), 0x5681},
    {F("Y_START_H"), 0x5682},
    {F("Y_START_L"), 0x5683},
    {F("X_WINDOW_H"), 0x5684},
    {F("X_WINDOW_L"), 0x5685},
    {F("Y_WINDOW_H"), 0x5686},
    {F("Y_WINDOW_L"), 0x5687},
    {F("VFIFO_CTRL0C"), 0x460C},
    {F("VFIFO_X_SIZE_H"), 0x4602},
    {F("VFIFO_X_SIZE_L"), 0x4603},
    {F("VFIFO_Y_SIZE_H"), 0x4604},
    {F("VFIFO_Y_SIZE_L"), 0x4605},
    {F("COMPRESSION_CTRL00"), 0x4400},
    {F("COMPRESSION_CTRL01"), 0x4401},
    {F("COMPRESSION_CTRL02"), 0x4402},
    {F("COMPRESSION_CTRL03"), 0x4403},
    {F("COMPRESSION_CTRL04"), 0x4404},
    {F("COMPRESSION_CTRL05"), 0x4405},
    {F("COMPRESSION_CTRL06"), 0x4406},
    {F("COMPRESSION_CTRL07"), 0x4407},
    {F("COMPRESSION_ISI_CTRL"), 0x4408},
    {F("COMPRESSION_CTRL09"), 0x4409},
    {F("COMPRESSION_CTRL0a"), 0x440a},
    {F("COMPRESSION_CTRL0b"), 0x440b},
    {F("COMPRESSION_CTRL0c"), 0x440c},
    {F("COMPRESSION_CTRL0d"), 0x440d},
    {F("COMPRESSION_CTRL0E"), 0x440e},
};

#define CNT_REG_NAME_TABLE \
    (sizeof(OV5640_reg_name_table) / sizeof(OV5640_reg_name_table[0]))

void OV5640::showRegisters(void) {
    uint8_t reg_value = 0;
    debug.println("\n*** Camera Registers ***");
    for (uint16_t ii = 0; ii < (sizeof(OV5640_reg_name_table) /
                                sizeof(OV5640_reg_name_table[0]));
         ii++) {
        cameraReadRegister(OV5640_reg_name_table[ii].reg, reg_value);
        debug.printf("%s(%x): %u(%x)\n", OV5640_reg_name_table[ii].reg_name,
                     OV5640_reg_name_table[ii].reg, reg_value, reg_value);
    }
    debug.println();
}